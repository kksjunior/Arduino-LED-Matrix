//  MERRY XMAS Scrolling Text Message
//
byte text[] = { //Array of columns used to write on matrix (You can modify text here)
0x0, 0x0, 0x0, 0x0, 0x0, 0x0, 0x0, 0x0, //Space
0x0, 0x7E, 0xFF, 0xC3, 0xDB, 0xDF, 0x5E, 0x0, //G
0x0, 0xFF, 0xFF, 0x3, 0x3, 0x3, 0x3, 0x0, //L
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0x0, 0x0, 0x0, 0x0, 0x0, 0x0, 0x0, 0x0, //Space
};
int pointer;
int column;
int pic;
void setup ()
{
DDRC = B00011111; //Set pins A0 to A5 as Output.
DDRB = B00000011; //Set pins 8 and 9 as Output.
DDRD = B11111111; //Set pins 0 to 7 as Output.
}
void loop ()
{
PORTC = B00000000; //All Columns OFF.
PORTB = B00000000; //All Columns OFF.
for (pointer=0; pointer < 110;pointer++){ //Load array pointer. 110 columns to limit array.
for (pic =0; pic < 5;pic++ ){ //Control how many times the picture is repeated (you can change speed scrolling text)
for (column=0; column < 8;column++) // Count number of column
{
if (column<=5)
{
PORTB = B00000000; //Columns 7 and 6 as disabled
PORTC = B00000001; column;
//set in sequence the columns 0 to 5 .
}
else
{
PORTC = B00000000; //
PORTB = B00000001; 
column-6; //set in sequence the columns 6 (Pin 8) and 7 (Pin 9)
}
PORTD = (text[pointer+column]); //Load column from the array to PORTD
delay (3); // Wait sometime for POV
PORTD = 0x00;
}
}
}
}

